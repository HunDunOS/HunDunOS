/* 混沌 自研引导器链接脚本
 *
 * 地址模型：标号的值 = 线性地址。
 *   BIOS 载入到 07C0:0000，boot1 第一件事就远跳到 0000:7C00 并把
 *   DS/ES/SS 一起归零。之后 标号值 直接就是物理地址，不再需要换算。
 *
 *   boot1  在 0x7C00（正好 512 字节，含 55AA）
 *   boot2  在 0x7E00（紧跟其后，El Torito 一次载入）
 *
 *   ★ 踩过的坑：
 *     1) boot1/boot2 分开汇编再 cat —— boot2 的标号从 0 起算，比实际
 *        位置少 0x200，消息串全读成空、全局变量错位。
 *     2) 段寄存器留 0x07C0 却把 GDT 基址/远跳目标当线性地址用 —— #GP
 *        → 三重故障。归零段寄存器后这两个问题一起消失。
 */
OUTPUT_FORMAT(elf32-i386)
ENTRY(_start)

SECTIONS
{
    . = 0x7C00;
    .boot1 0x7C00 : { *(.boot1) }

    . = 0x7E00;
    .boot2 0x7E00 : { *(.boot2) }
}
